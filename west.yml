## west.yml
```yaml
manifest:
    remotes:
      - name: ncs
        url-base: https://github.com/nrfconnect
    projects:
      - name: nrf
        repo-path: sdk-nrf
        remote: ncs
        revision: master
        import: true
    self:
      path: bt-ble-mesh
```
